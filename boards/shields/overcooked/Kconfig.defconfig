## boards/shields/overcooked/Kconfig.defconfig
```kconfig
if SHIELD_OVERCOOKED_DONGLE

config ZMK_KEYBOARD_NAME
    default "Overcooked"

config ZMK_SPLIT_ROLE_CENTRAL
    default y

config ZMK_STUDIO
    default y

config ZMK_MOUSE
    default y

config ZMK_SPLIT
    default y

config ZMK_SPLIT_BLE_CENTRAL_PERIPHERALS
    default 2

endif

# if SHIELD_OVERCOOKED_LEFT

# Name must be less than 16 characters long!
# config ZMK_KEYBOARD_NAME
#     default "Overcooked"

# config ZMK_SPLIT_ROLE_CENTRAL
#     default y

# endif

if SHIELD_OVERCOOKED_LEFT || SHIELD_OVERCOOKED_RIGHT

config ZMK_SPLIT
    default y

endif
```

## boards/shields/overcooked/Kconfig.shield
```kconfig
# No whitespace after the comma or in your part name!
config SHIELD_OVERCOOKED_LEFT
    def_bool $(shields_list_contains,overcooked_left)

# No whitespace after the comma or in your part name!
config SHIELD_OVERCOOKED_RIGHT
    def_bool $(shields_list_contains,overcooked_right)

# No whitespace after the comma or in your part name!
config SHIELD_OVERCOOKED_DONGLE
    def_bool $(shields_list_contains,overcooked_dongle)
```
