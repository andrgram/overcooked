## config/west.yml
```yaml
manifest:
  defaults:
    revision: v0.3
  remotes:
    - name: zmkfirmware
      url-base: https://github.com/zmkfirmware
    # Additional modules containing boards/shields/custom code can be listed here as well
    # See https://docs.zephyrproject.org/3.2.0/develop/west/manifest.html#projects
    - name: englmaxi
      url-base: https://github.com/englmaxi
  projects:
    - name: zmk
      remote: zmkfirmware
      import: app/west.yml
    - name: zmk-dongle-display
      remote: englmaxi
      revision: v0.3  # main targets ZMK v0.4 / Zephyr 4.1 since 2025-12; keep in step with the zmk pin above
  self:
    path: config
```
